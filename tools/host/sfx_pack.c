/* Encode prefiltered 16 kHz mono s16le effects with the firmware IMA encoder. */
#include <stdio.h>
#include <stdlib.h>
#include <stdint.h>
#include <math.h>
#include "adpcm.h"
int main(void)
{
    const char *name[]={"bonk","crack","shatter","tinkle"};
    FILE *out=fopen("main/sfx_samples.h","w");if(!out)return 1;
    fputs("/* Generated by tools/host/glass_sounds.sh. CC0 sources: docs/expressions/GLASS_SOUNDS.md. */\n#pragma once\n#include <stdint.h>\n",out);
    for(int k=0;k<4;k++) {
        char path[128];snprintf(path,sizeof path,"tools/host/out/glass/%s.pcm",name[k]);
        FILE *f=fopen(path,"rb");if(!f){perror(path);return 1;}
        fseek(f,0,SEEK_END);long bytes=ftell(f);rewind(f);int n=(bytes/2)&~1;
        if(n<2||n>32000)return 1;
        int16_t *pcm=calloc(n,sizeof *pcm);uint8_t *ad=calloc(n/2,1);
        if(!pcm||!ad||fread(pcm,2,n,f)!=(size_t)n)return 1;fclose(f);
        double energy=0;int peak=0;for(int i=0;i<n;i++){energy+=(double)pcm[i]*pcm[i];if(abs(pcm[i])>peak)peak=abs(pcm[i]);}
        double gain=fmin(66000./(peak?peak:1),6500./sqrt(energy/n+1));
        for(int i=0;i<n;i++)pcm[i]=(int16_t)(22000*tanh(pcm[i]*gain/22000.));
        energy=0;peak=0;for(int i=0;i<n;i++){energy+=(double)pcm[i]*pcm[i];if(abs(pcm[i])>peak)peak=abs(pcm[i]);}
        adpcm_state_t st={0};adpcm_encode(&st,pcm,ad,n);
        fprintf(out,"static const uint8_t sfx_%s[%d]={\n",name[k],n/2);
        for(int i=0;i<n/2;i++)fprintf(out,"0x%02x,%s",ad[i],i%24==23?"\n":"");
        fputs("\n};\n",out);printf("%s: %.3f s, %d ADPCM bytes, peak %d RMS %.0f\n",name[k],n/16000.,n/2,peak,sqrt(energy/n));
        free(pcm);free(ad);
    }
    return fclose(out)!=0;
}
